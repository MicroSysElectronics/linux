## kernel-comels1046a.its
```
/dts-v1/;

/ {
        description = "U-Boot fitImage for comels1046a";
        #address-cells = <2>;
        #size-cells = <1>;

        images {
                kernel-microsys_comels1046a {
                        reg = <0x00 0x80080000 0x00>;
                        description = "Linux kernel";
                        data = /incbin/("arch/arm64/boot/Image");
                        type = "kernel";
                        arch = "arm64";
                        os = "linux";
                        compression = "none";
                        load = <0x80080000>;
                        entry = <0x80080000>;
                        hash-1 {
                            algo = "sha1";
                        };
                };
                fdt-microsys_comels1046a-ritec.dtb {
                        reg = <0x00 0x90000000 0x00>;
                        description = "Flattened Device Tree blob";
                        data = /incbin/("arch/arm64/boot/dts/freescale/comels1046a-ritec.dtb");
                        type = "flat_dt";
                        arch = "arm64";
                        compression = "none";
                        load = <0x90000000>;
                        hash-1 {
                            algo = "sha1";
                        };
                };
        };

        configurations {
            default = "conf-microsys_comels1046a-ritec.dtb";
            conf-microsys_comels1046a-ritec.dtb {
                description = "1 Linux kernel, FDT blob";
                kernel = "kernel-microsys_comels1046a";
                fdt = "fdt-microsys_comels1046a-ritec.dtb";
                hash-1 {
                    algo = "sha1";
                };
            };
        };
};
```

## kernel-mpxls1028crx07.its
```
/dts-v1/;

/ {
        description = "U-Boot fitImage for mpxls1028crx07";
        #address-cells = <2>;
        #size-cells = <1>;

        images {
                kernel-microsys_mpxls1028 {
                        reg = <0x00 0x80080000 0x00>;
                        description = "Linux kernel";
                        data = /incbin/("arch/arm64/boot/Image");
                        type = "kernel";
                        arch = "arm64";
                        os = "linux";
                        compression = "none";
                        load = <0x81080000>;
                        entry = <0x81080000>;
                        hash-1 {
                            algo = "sha1";
                        };
                };
                fdt-microsys_mpxls1028-crx07.dtb {
                        reg = <0x00 0x90000000 0x00>;
                        description = "Flattened Device Tree blob";
                        data = /incbin/("arch/arm64/boot/dts/freescale/mpxls1028-crx07.dtb");
                        type = "flat_dt";
                        arch = "arm64";
                        compression = "none";
                        load = <0x90000000>;
                        hash-1 {
                            algo = "sha1";
                        };
                };
        };

        configurations {
            default = "conf-microsys_mpxls1028-crx07.dtb";
            conf-microsys_mpxls1028-crx07.dtb {
                description = "1 Linux kernel, FDT blob";
                kernel = "kernel-microsys_mpxls1028";
                fdt = "fdt-microsys_mpxls1028-crx07.dtb";
                hash-1 {
                    algo = "sha1";
                };
            };
        };
};
```

## kernel-mpxls10xx.its
```
/*
 * Copyright (C) 2015, Freescale Semiconductor
 * (C) Copyright 2018 MicroSys Electronics GmbH
 *
 * Mingkai Hu <Mingkai.hu@freescale.com>
 * Hou Zhiqiang <B48286@freescale.com>
 *
 * This file is licensed under the terms of the GNU General Public
 * License version 2.  This program is licensed "as is" without any
 * warranty of any kind, whether express or implied.
 */

/dts-v1/;

/ {
	description = "Image file for the MPXLS10xx Linux Kernel";
	#address-cells = <1>;

	images {
		kernel-mpx10xx {
			description = "ARM64 Linux kernel";
			data = /incbin/("./arch/arm64/boot/Image.gz");
			type = "kernel";
			arch = "arm64";
			os = "linux";
			compression = "gzip";
			load  = <0x81200000>;
			entry = <0x81200000>;
		};
		fdt-mpxls1046 {
			description = "MPXLS1046/CRX05 Flattened Device Tree blob";
			data = /incbin/("./arch/arm64/boot/dts/freescale/mpxls1046.dtb");
			type = "flat_dt";
			arch = "arm64";
			compression = "none";
			load = <0x90000000>;
		};
		fdt-mpxls1046_crx06_xfi {
			description = "MPXLS1046/CRX06/XFI Flattened Device Tree blob";
			data = /incbin/("./arch/arm64/boot/dts/freescale/mpxls1046_crx06_xfi.dtb");
			type = "flat_dt";
			arch = "arm64";
			compression = "none";
			load = <0x90000000>;
		};
		fdt-mpxls1046_crx06_qsgmii {
			description = "MPXLS1046/CRX06/QSGMII Flattened Device Tree blob";
			data = /incbin/("./arch/arm64/boot/dts/freescale/mpxls1046_crx06_qsgmii.dtb");
			type = "flat_dt";
			arch = "arm64";
			compression = "none";
			load = <0x90000000>;
		};
		fdt-mpxls1043 {
			description = "MPXLS1043/CRX05 Flattened Device Tree blob";
			data = /incbin/("./arch/arm64/boot/dts/freescale/mpxls1043.dtb");
			type = "flat_dt";
			arch = "arm64";
			compression = "none";
			load = <0x90000000>;
		};
		fdt-mpxls1088_crx05 {
			description = "MPXLS1088/CRX05 Flattened Device Tree blob";
			data = /incbin/("./arch/arm64/boot/dts/freescale/mpxls1088_crx05.dtb");
			type = "flat_dt";
			arch = "arm64";
			compression = "none";
			load = <0x90000000>;
		};
		fdt-mpxls1088_crx06_2qsgmii {
			description = "MPXLS1088/CRX06/2QSGMII Flattened Device Tree blob";
			data = /incbin/("./arch/arm64/boot/dts/freescale/mpxls1088_crx06_2qsgmii.dtb");
			type = "flat_dt";
			arch = "arm64";
			compression = "none";
			load = <0x90000000>;
		};
		fdt-mpxls1088_crx06_2tsn {
			description = "MPXLS1088/CRX06/2TSN Flattened Device Tree blob";
			data = /incbin/("./arch/arm64/boot/dts/freescale/mpxls1088_crx06_2tsn.dtb");
			type = "flat_dt";
			arch = "arm64";
			compression = "none";
			load = <0x90000000>;
		};
	};

	configurations {
		default = "mpxls1046";
		mpxls1046 {
			description = "MPXLS1046/CRX05 Linux Kernel";
			kernel = "kernel-mpx10xx";
			fdt = "fdt-mpxls1046";
		};
		mpxls1046_crx06_xfi {
			description = "MPXLS1046/CRX06 Linux Kernel XFI";
			kernel = "kernel-mpx10xx";
			fdt = "fdt-mpxls1046_crx06_xfi";
		};
		mpxls1046_crx06_qsgmii {
			description = "MPXLS1046/CRX06 Linux Kernel QSGMII";
			kernel = "kernel-mpx10xx";
			fdt = "fdt-mpxls1046_crx06_qsgmii";
		};
		mpxls1043 {
			description = "MPXLS1043/CRX05 Linux Kernel";
			kernel = "kernel-mpx10xx";
			fdt = "fdt-mpxls1043";
		};
		mpxls1088 {
			description = "MPXLS1088/CRX05 Linux Kernel";
			kernel = "kernel-mpx10xx";
			fdt = "fdt-mpxls1088_crx05";
		};
		mpxls1088_crx06_2qsgmii {
			description = "MPXLS1088/CRX06 Linux Kernel 2xQSGMII";
			kernel = "kernel-mpx10xx";
			fdt = "fdt-mpxls1088_crx06_2qsgmii";
		};
		mpxls1088_crx06_2tsn {
			description = "MPXLS1088/CRX06 Linux Kernel 2xTSN";
			kernel = "kernel-mpx10xx";
			fdt = "fdt-mpxls1088_crx06_2tsn";
		};
	};
};
```

## kernel-mpxlx2160acrx08.its
```
/dts-v1/;

/ {
        description = "U-Boot fitImage for mpxlx2160acrx08";
        #address-cells = <2>;
        #size-cells = <1>;

        images {
                kernel-microsys_mpxlx2160a {
                        reg = <0x00 0x81080000 0x00>;
                        description = "Linux kernel";
                        data = /incbin/("arch/arm64/boot/Image");
                        type = "kernel";
                        arch = "arm64";
                        os = "linux";
                        compression = "none";
                        load = <0x81080000>;
                        entry = <0x81080000>;
                        hash-1 {
                            algo = "sha1";
                        };
                };
                fdt-microsys_mpxlx2160a-crx08.dtb {
                        reg = <0x00 0x90000000 0x00>;
                        description = "Flattened Device Tree blob";
                        data = /incbin/("arch/arm64/boot/dts/freescale/mpxlx2160a-crx08.dtb");
                        type = "flat_dt";
                        arch = "arm64";
                        compression = "none";
                        load = <0x90000000>;
                        hash-1 {
                            algo = "sha1";
                        };
                };
        };

        configurations {
            default = "conf-microsys_mpxlx2160a-crx08.dtb";
            conf-microsys_mpxlx2160a-crx08.dtb {
                description = "1 Linux kernel, FDT blob";
                kernel = "kernel-microsys_mpxlx2160a";
                fdt = "fdt-microsys_mpxlx2160a-crx08.dtb";
                hash-1 {
                    algo = "sha1";
                };
            };
        };
};
```

## kernel-s32g274asbc2.its
```
/*
 * Copyright (C) 2021 MicroSys Electronics GmbH
 * Author: Kay Potthoff <kay.potthoff@microsys.de>
 */

/dts-v1/;

/ {
        description = "U-Boot fitImage for S32G274ASBC2";
        #address-cells = <1>;

        images {
                kernel-s32g274asbc2 {
                        description = "Linux kernel S32G274ASBC2";
                        data = /incbin/("arch/arm64/boot/Image.gz");
                        type = "kernel";
                        arch = "arm64";
                        os = "linux";
                        compression = "gzip";
                        load = <0x80000000>;
                        entry = <0x80000000>;
                        hash-1 {
                            algo = "sha1";
                        };
                };
                fdt-s32g274asbc2_m2 {
                        description = "Flattened Device Tree S32G274ASBC2/M.2";
                        data = /incbin/("arch/arm64/boot/dts/freescale/s32g274asbc2_m2.dtb");
                        type = "flat_dt";
                        arch = "arm64";
                        compression = "none";
                        load = <0x83E00000>;
                        hash-1 {
                            algo = "sha1";
                        };
                };
                fdt-s32g274asbc2_2g5 {
                        description = "Flattened Device Tree S32G274ASBC2/2.5Gb";
                        data = /incbin/("arch/arm64/boot/dts/freescale/s32g274asbc2_2g5.dtb");
                        type = "flat_dt";
                        arch = "arm64";
                        compression = "none";
                        load = <0x83E00000>;
                        hash-1 {
                            algo = "sha1";
                        };
                };
        };

        configurations {
                default = "conf-s32g274asbc2_m2";
                conf-s32g274asbc2_m2 {
                    description = "S32G274ASBC2 with M.2";
                    kernel = "kernel-s32g274asbc2";
                    fdt = "fdt-s32g274asbc2_m2";
                    hash-1 {
                        algo = "sha1";
                    };
                };
                conf-s32g274asbc2_2g5 {
                    description = "S32G274ASBC2 with 2.5Gb";
                    kernel = "kernel-s32g274asbc2";
                    fdt = "fdt-s32g274asbc2_2g5";
                    hash-1 {
                        algo = "sha1";
                    };
                };
        };
};
```

## kernel-s32g274asbc3.its
```
/*
 * Copyright (C) 2022 MicroSys Electronics GmbH
 * Author: Kay Potthoff <kay.potthoff@microsys.de>
 */

/dts-v1/;

/ {
        description = "U-Boot fitImage for S32G274ASBC3";
        #address-cells = <1>;

        images {
                kernel-s32g274asbc3 {
                        description = "Linux kernel S32G274ASBC3";
                        data = /incbin/("arch/arm64/boot/Image.gz");
                        type = "kernel";
                        arch = "arm64";
                        os = "linux";
                        compression = "gzip";
                        load = <0x80000000>;
                        entry = <0x80000000>;
                        hash-1 {
                            algo = "sha1";
                        };
                };
                fdt-s32g274asbc3_m2 {
                        description = "Flattened Device Tree S32G274ASBC3/M.2";
                        data = /incbin/("arch/arm64/boot/dts/freescale/s32g274asbc3_m2.dtb");
                        type = "flat_dt";
                        arch = "arm64";
                        compression = "none";
                        load = <0x83E00000>;
                        hash-1 {
                            algo = "sha1";
                        };
                };
                fdt-s32g274asbc3_2g5 {
                        description = "Flattened Device Tree S32G274ASBC3/2.5Gb";
                        data = /incbin/("arch/arm64/boot/dts/freescale/s32g274asbc3_2g5.dtb");
                        type = "flat_dt";
                        arch = "arm64";
                        compression = "none";
                        load = <0x83E00000>;
                        hash-1 {
                            algo = "sha1";
                        };
                };
        };

        configurations {
                default = "conf-s32g274asbc3_m2";
                conf-s32g274asbc3_m2 {
                    description = "S32G274ASBC3 with M.2";
                    kernel = "kernel-s32g274asbc3";
                    fdt = "fdt-s32g274asbc3_m2";
                    hash-1 {
                        algo = "sha1";
                    };
                };
                conf-s32g274asbc3_2g5 {
                    description = "S32G274ASBC3 with 2.5Gb";
                    kernel = "kernel-s32g274asbc3";
                    fdt = "fdt-s32g274asbc3_2g5";
                    hash-1 {
                        algo = "sha1";
                    };
                };
        };
};
```
